## ai_vox3/app/day2_ui/Kconfig
```kconfig
#
# Day 2 UI Demo - Contest 2026 team 307
#

config LVX_CONTEST2026_307_DAY2_UI
	bool "Day 2 UI demo (clock + popup + reminder)"
	default n
	depends on GRAPHICS_LVGL
	depends on RTC
	---help---
		Day 2 UI 组件演示：时钟、弹窗、课程提醒页面。

if LVX_CONTEST2026_307_DAY2_UI

config LVX_CONTEST2026_307_DAY2_UI_PROGNAME
	string "Program name"
	default "day2_ui"

config LVX_CONTEST2026_307_DAY2_UI_PRIORITY
	int "Task priority"
	default 100

config LVX_CONTEST2026_307_DAY2_UI_STACKSIZE
	int "Stack size"
	default 65536

endif

config LVX_CONTEST2026_307_TOUCH_TEST
	bool "Touch screen test utility"
	default n
	depends on INPUT_TOUCHSCREEN
	---help---
		触摸屏最小测试工具：读取并打印触摸坐标。

if LVX_CONTEST2026_307_TOUCH_TEST

config LVX_CONTEST2026_307_TOUCH_TEST_PROGNAME
	string "Program name"
	default "touch_test"

config LVX_CONTEST2026_307_TOUCH_TEST_PRIORITY
	int "Task priority"
	default 100

config LVX_CONTEST2026_307_TOUCH_TEST_STACKSIZE
	int "Stack size"
	default 4096

endif

config LVX_CONTEST2026_307_FONT_TEST
	bool "Chinese font test utility"
	default n
	depends on GRAPHICS_LVGL
	---help---
		中文字体测试工具：验证 FreeType 字体加载和中文显示。

if LVX_CONTEST2026_307_FONT_TEST

config LVX_CONTEST2026_307_FONT_TEST_PROGNAME
	string "Program name"
	default "font_test"

config LVX_CONTEST2026_307_FONT_TEST_PRIORITY
	int "Task priority"
	default 100

config LVX_CONTEST2026_307_FONT_TEST_STACKSIZE
	int "Stack size"
	default 32768

endif
```

## ai_vox3/app/info_screen/Kconfig
```kconfig
#
# Info Screen - Contest 2026 team 307
#

config LVX_CONTEST2026_307_INFO_SCREEN
	bool "Info screen (time + weather) on fb0"
	default n
	depends on VIDEO_FB
	---help---
		Framebuffer-rendered info page: big HH:MM clock on the first line and
		"weekday weather temp" on the second line. Reads the weather from
		/tmp/weather.txt (written by the ai_agent weather tool). Pure fb
		direct-draw, no LVGL/FreeType. Falls back to "--" when time/weather
		are unavailable.

if LVX_CONTEST2026_307_INFO_SCREEN

config LVX_CONTEST2026_307_INFO_SCREEN_PROGNAME
	string "Program name"
	default "info_screen"

config LVX_CONTEST2026_307_INFO_SCREEN_PRIORITY
	int "Task priority"
	default 100

config LVX_CONTEST2026_307_INFO_SCREEN_STACKSIZE
	int "Stack size"
	default 4096

endif
```

## ai_vox3/app/status_indicator/Kconfig
```kconfig
#
# Status Indicator - Contest 2026 team 307
#

config LVX_CONTEST2026_307_STATUS_INDICATOR
	bool "Status indicator system (status bar + motor)"
	default n
	depends on VIDEO_FB
	---help---
		设备状态指示系统：顶部 4px 状态色带 + 马达震动联动。
		使用 framebuffer 直绘，不依赖 LVGL。
		支持 Normal/Notify/Alert/Sleep 四种状态。

if LVX_CONTEST2026_307_STATUS_INDICATOR

config LVX_CONTEST2026_307_STATUS_INDICATOR_PROGNAME
	string "Program name"
	default "status_indicator"

config LVX_CONTEST2026_307_STATUS_INDICATOR_PRIORITY
	int "Task priority"
	default 100

config LVX_CONTEST2026_307_STATUS_INDICATOR_STACKSIZE
	int "Stack size"
	default 8192

endif
```

## ai_vox3/app/xiaozhi_ui/Kconfig
```kconfig
#
# XiaoZhi-style LVGL UI - Contest 2026 team 307
#

config LVX_CONTEST2026_307_XIAOZHI_UI
	bool "XiaoZhi-style LVGL UI on fb0"
	default n
	depends on GRAPHICS_LVGL
	---help---
		Port of the XiaoZhi assistant UI (top bar with network/mute/battery
		icons, centre status text, chat content area) to openvela LVGL.
		Renders through the NuttX LVGL fbdev backend on /dev/fb0.

if LVX_CONTEST2026_307_XIAOZHI_UI

config LVX_CONTEST2026_307_XIAOZHI_UI_PROGNAME
	string "Program name"
	default "xiaozhi_ui"

config LVX_CONTEST2026_307_XIAOZHI_UI_PRIORITY
	int "Task priority"
	default 100

config LVX_CONTEST2026_307_XIAOZHI_UI_STACKSIZE
	int "Stack size"
	default 16384

endif
```
